## tests/zephyr/testcase.yaml
```yaml
tests:
  sendspin.zephyr:
    tags:
      - sendspin
      - net
    platform_allow:
      - qemu_cortex_a9
      - native_sim/native/64
    integration_platforms:
      - native_sim/native/64
  sendspin.zephyr.static_stacks:
    tags: [sendspin, net]
    platform_allow: [native_sim/native/64]
    integration_platforms: [native_sim/native/64]
    extra_configs:
      - CONFIG_SENDSPIN_STATIC_THREAD_STACKS=y
      - CONFIG_SENDSPIN_THREAD_STACK_SIZE=12288
      - CONFIG_SENDSPIN_THREAD_COUNT=4
      - CONFIG_HEAP_MEM_POOL_SIZE=51000
```

## zephyr/Kconfig
```kconfig
# Copyright 2026 Sendspin Contributors
# SPDX-License-Identifier: Apache-2.0

menuconfig SENDSPIN
	bool "Sendspin synchronized audio client"
	depends on CPP && STD_CPP_VERSION >= 202002
	depends on NETWORKING && MULTITHREADING
	select REQUIRES_FULL_LIBCPP
	select WEBSOCKET_CLIENT
	select MBEDTLS_PSA_CRYPTO_C if !BUILD_WITH_TFM
	select PSA_WANT_ALG_SHA_1
	select THREAD_STACK_INFO
	select DYNAMIC_THREAD
	select DYNAMIC_THREAD_ALLOC
	help
	  Build sendspin-cpp with native Zephyr threads and an outbound ws://
	  transport. Connect explicitly with SendspinClient::connect_to().
	  Supports PCM and FLAC. The application supplies networking readiness,
	  persistence and audio callbacks. No inbound listener or Opus codec.

if SENDSPIN

config SENDSPIN_ENABLE_PLAYER
	bool "Player role (PCM and FLAC decoding)"
	default y

config SENDSPIN_ENABLE_CONTROLLER
	bool "Controller role"
	default y

config SENDSPIN_ENABLE_METADATA
	bool "Metadata role"
	default y

config SENDSPIN_ENABLE_COLOR
	bool "Color role"

config SENDSPIN_ENABLE_ARTWORK
	bool "Artwork role"

config SENDSPIN_ENABLE_VISUALIZER
	bool "Visualizer role"

config SENDSPIN_ENABLE_SOURCE
	bool "Source role (PCM and FLAC encoding)"

config SENDSPIN_STATIC_THREAD_STACKS
	bool "Reserve a separate pool of Sendspin worker stacks"
	depends on !USERSPACE
	help
	  Keep worker stacks out of the shared kernel heap. Stacks use internal
	  RAM unless SENDSPIN_THREAD_STACKS_PSRAM is explicitly enabled.

config SENDSPIN_THREAD_STACKS_PSRAM
	bool "Place reserved worker stacks in ESP PSRAM"
	depends on SENDSPIN_STATIC_THREAD_STACKS && ESP_SPIRAM
	help
	  Save internal RAM at the cost of external-memory access latency.
	  Workers with these stacks must not access flash while its cache is
	  disabled; persistence callbacks must use an internal application stack.

config SENDSPIN_THREAD_COUNT
	int "Maximum concurrent Sendspin workers"
	depends on SENDSPIN_STATIC_THREAD_STACKS
	default 4
	range 1 16

config SENDSPIN_THREAD_STACK_SIZE
	int "Minimum stack size per Sendspin thread"
	default 8192
	range 2048 262144
	help
	  Stack sizes from the client/role configs are clamped to at least this
	  size. With STATIC_THREAD_STACKS, each reserved stack has this size
	  and larger requests fail. Otherwise stacks use the Zephyr system
	  heap (HEAP_MEM_POOL_SIZE). Tune using stack analysis on the board.

config SENDSPIN_THREAD_PRIORITY
	int "Base Zephyr preemptive priority"
	default 8
	range 0 15
	help
	  Corresponds to Sendspin priority 5. Larger Sendspin priorities get
	  smaller Zephyr priority numbers, clamped to the available range.

config SENDSPIN_BUFFER_HEAP_SIZE
	int "Dedicated Sendspin buffer heap size"
	default 0
	range 0 4194304
	help
	  Reserve a bounded heap for platform buffers, in PSRAM when ESP_SPIRAM
	  is enabled. Zero uses the C heap. Internal placement preferences use
	  the same buffer heap; thread control blocks and C++ objects do not.

config SENDSPIN_KERNEL_MALLOC
	bool "Use the kernel heap for C/C++ allocation"
	depends on !NATIVE_BUILD
	help
	  Wrap malloc, calloc, realloc and free with the kernel allocator for
	  the whole application. Set COMMON_LIBC_MALLOC_ARENA_SIZE to zero.

module = SENDSPIN
module-str = sendspin
source "subsys/logging/Kconfig.template.log_config"

endif
```
