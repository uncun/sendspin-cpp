## CMakeLists.txt
```
# SPDX-License-Identifier: Apache-2.0
cmake_minimum_required(VERSION 3.20.0)
find_package(Zephyr REQUIRED HINTS $ENV{ZEPHYR_BASE})
project(sendspin_zephyr_tests LANGUAGES C CXX)
target_sources(app PRIVATE src/main.cpp src/transport.cpp)
target_link_libraries(app PRIVATE mbedTLS)
target_include_directories(app PRIVATE ../../src ../../src/zephyr)
target_include_directories(app PRIVATE ${SENDSPIN_NOISE_DIR}/include ${SENDSPIN_ARDUINOJSON_DIR}/src)
```

## prj.conf
```kconfig
CONFIG_ZTEST=y
CONFIG_THREAD_NAME=y
CONFIG_CPP=y
CONFIG_STD_CPP20=y
CONFIG_SENDSPIN=y
CONFIG_SENDSPIN_ENABLE_PLAYER=y
CONFIG_SENDSPIN_ENABLE_SOURCE=y
CONFIG_SENDSPIN_ENABLE_COLOR=y
CONFIG_SENDSPIN_ENABLE_ARTWORK=y
CONFIG_SENDSPIN_ENABLE_VISUALIZER=y
CONFIG_NETWORKING=y
CONFIG_NET_IPV4=y
CONFIG_NET_TCP=y
CONFIG_NET_LOOPBACK=y
CONFIG_TEST_RANDOM_GENERATOR=y
CONFIG_TEST_CSPRNG_GENERATOR=y
CONFIG_MAIN_STACK_SIZE=16384
CONFIG_ZTEST_STACK_SIZE=16384
CONFIG_HEAP_MEM_POOL_SIZE=131072
CONFIG_WEBSOCKET_MAX_CONTEXTS=2
CONFIG_STACK_SENTINEL=y
CONFIG_PSA_WANT_ALG_SHA_1=y
CONFIG_SENDSPIN_BUFFER_HEAP_SIZE=262144
```

## boards/native_sim_native_64.conf
```kconfig
CONFIG_NET_DRIVERS=y
CONFIG_ETH_NATIVE_TAP=n
```

## boards/qemu_cortex_a9.conf
```kconfig
CONFIG_NEWLIB_LIBC=y
CONFIG_NEWLIB_LIBC_MIN_REQUIRED_HEAP_SIZE=1048576
CONFIG_NET_QEMU_SLIP=y
CONFIG_NET_SLIP_TAP=n
```

## src/main.cpp
```c
// Copyright 2026 Sendspin Contributors
// SPDX-License-Identifier: Apache-2.0
#include "platform/event_flags.h"
#include "platform/memory.h"
#include "platform/shared_ring_buffer.h"
#include "platform/thread.h"
#include "platform/time.h"
#include "sendspin/client.h"
#include <zephyr/ztest.h>

#include <cstring>
#include <utility>

using namespace sendspin;

ZTEST(sendspin_zephyr, test_thread_move_join_and_flags) {
    EventFlags flags;
    zassert_true(flags.create());
    auto worker = platform_create_thread(
        {.name = "SsTest", .stack_size = 4096, .priority = 5},
        [](EventFlags* state) {
            state->wait(1, true, true, UINT32_MAX);
            state->set(2);
        },
        &flags);
    PlatformThread moved(std::move(worker));
    zassert_false(worker.joinable());
    flags.set(1);
    zassert_equal(flags.wait(2, true, true, 1000) & 2, 2);
    moved.join();
    zassert_false(moved.joinable());
}

namespace {
struct ThreadObservation {
    int priority{0};
    const char* name{nullptr};
    EventFlags done;
};
void observe_thread(ThreadObservation* observed) {
    observed->priority = k_thread_priority_get(k_current_get());
    observed->name = k_thread_name_get(k_current_get());
    observed->done.set(1);
    observed->done.wait(2, false, false, UINT32_MAX);
}
}  // namespace

ZTEST(sendspin_zephyr, test_concurrent_thread_creation_keeps_configuration) {
    ThreadObservation first;
    ThreadObservation second;
    first.done.create();
    second.done.create();
    EventFlags ready;
    ready.create();
    // One caller waits while another creates a child; pending configuration must stay local.
    auto parent = platform_create_thread(
        {.name = "Parent", .stack_size = 4096, .priority = 5},
        [&](ThreadObservation* observed) {
            const ThreadConfig config{.name = "CallerA", .stack_size = 4096, .priority = 5};
            ready.set(1);
            ready.wait(2, false, false, UINT32_MAX);
            auto worker = platform_create_thread(config, observe_thread, observed);
            observed->done.wait(1, false, false, UINT32_MAX);
            ready.set(4);
            worker.join();
        },
        &first);
    ready.wait(1, false, false, UINT32_MAX);
    auto worker = platform_create_thread({.name = "CallerB", .stack_size = 4096, .priority = 7},
                                         observe_thread, &second);
    second.done.wait(1, false, false, UINT32_MAX);
    ready.set(2);
    ready.wait(4, false, false, UINT32_MAX);
    // Inspect before exit: the kernel-owned names must remain alive.
    zassert_equal(first.priority, CONFIG_SENDSPIN_THREAD_PRIORITY);
    zassert_equal(second.priority, CONFIG_SENDSPIN_THREAD_PRIORITY - 2);
    zassert_equal(std::strcmp(first.name, "CallerA"), 0);
    zassert_equal(std::strcmp(second.name, "CallerB"), 0);
    first.done.set(2);
    second.done.set(2);
    worker.join();
    parent.join();
}

ZTEST(sendspin_zephyr, test_flags_timeout_and_clear) {
    EventFlags flags;
    flags.create();
    flags.set(2);
    zassert_equal(flags.wait(1, false, false, 20) & 1, 0);
    zassert_equal(flags.get() & 2, 2);
    flags.set(3);
    zassert_equal(flags.wait(3, true, true, 0) & 3, 3);
    zassert_equal(flags.wait(3, false, false, 0) & 3, 0);
}

ZTEST(sendspin_zephyr, test_ring_out_of_order_returns) {
    alignas(8) uint8_t storage[128]{};
    SharedRingBuffer ring;
    zassert_true(ring.create(sizeof(storage), storage));
    void* first = ring.acquire(32, 0);
    void* second = ring.acquire(32, 0);
    zassert_not_null(first);
    zassert_not_null(second);
    std::memset(first, 0x11, 32);
    std::memset(second, 0x22, 32);
    ring.complete(second);
    size_t size = 0;
    zassert_is_null(ring.take(&size, 0));
    ring.complete(first);
    zassert_equal_ptr(ring.take(&size, 0), first);
    zassert_equal_ptr(ring.take(&size, 0), second);
    ring.return_item(second);
    zassert_is_null(ring.acquire(48, 0));
    ring.return_item(first);
    zassert_not_null(ring.acquire(48, 0));
}

class OfflineNetwork final : public SendspinNetworkProvider {
public:
    bool is_network_ready() override {
        return false;
    }
};

ZTEST(sendspin_zephyr, test_client_restart) {
    OfflineNetwork network;
    SendspinClientConfig config;
    config.name = "Zephyr lifecycle test";
    SendspinClient client(config);
    client.set_network_provider(&network);
    client.add_metadata();
    client.add_controller();
    for (int i = 0; i < 3; ++i) {
        zassert_true(client.start());
        client.loop();
        k_sleep(K_MSEC(10));
        client.stop();
    }
}

ZTEST(sendspin_zephyr, test_cycle_counter_wrap_and_idle) {
    sendspin::detail::CycleClock32 clock;
    const uint64_t start = 0xfffffff0U;
    zassert_equal(clock.update(start, 0), start);
    zassert_equal(clock.update(0x10, 32), start + 32);
    // More than two complete counter periods pass without a read.
    const uint64_t idle = (uint64_t{2} << 32) + 100;
    zassert_equal(clock.update(0x74, 32 + idle), start + 32 + idle);
    // A coarse tick boundary may put uptime slightly ahead of the cycle delta.
    zassert_equal(clock.update(0x78, 32 + idle + 1000), start + 32 + idle + 4);
}

ZTEST(sendspin_zephyr, test_buffer_heap_realloc_and_exhaustion) {
    platform_free(nullptr);
    auto* data = static_cast<uint8_t*>(platform_realloc(nullptr, 128));
    zassert_not_null(data);
    std::memset(data, 0x5a, 128);
    auto* grown = static_cast<uint8_t*>(platform_realloc(data, 256));
    zassert_not_null(grown);
    for (size_t i = 0; i < 128; ++i) {
        zassert_equal(grown[i], 0x5a);
    }
#if CONFIG_SENDSPIN_BUFFER_HEAP_SIZE > 0
    zassert_is_null(platform_realloc(grown, CONFIG_SENDSPIN_BUFFER_HEAP_SIZE * 2));
    zassert_equal(grown[0], 0x5a);
#endif
    platform_free(grown);
    void* internal = platform_malloc_internal(128);
    zassert_not_null(internal);
    platform_free(internal);
}

#if CONFIG_SENDSPIN_BUFFER_HEAP_SIZE > 0
ZTEST(sendspin_zephyr, test_thread_refuses_exhausted_control_blocks_and_can_retry) {
    EventFlags done;
    done.create();
    // Each allocation is smaller than a worker control block, so any remainder
    // cannot hide a successful worker allocation after the loop fills this heap.
    void* blocks[CONFIG_SENDSPIN_BUFFER_HEAP_SIZE / sizeof(k_thread)];
    size_t count = 0;
    while (count < std::size(blocks)) {
        void* block = platform_malloc_internal(sizeof(k_thread));
        if (block == nullptr) {
            break;
        }
        blocks[count++] = block;
    }
    const auto signal = [](EventFlags* flags) { flags->set(1); };
    PlatformThread worker(signal, &done);
    zassert_false(worker.joinable());
    for (size_t i = 0; i < count; ++i) {
        platform_free(blocks[i]);
    }
    // Control: allocation failure must leave the object reusable.
    worker = PlatformThread(signal, &done);
    zassert_true(worker.joinable());
    done.wait(1, false, false, UINT32_MAX);
    worker.join();
}
#endif

#ifdef CONFIG_SENDSPIN_STATIC_THREAD_STACKS
ZTEST(sendspin_zephyr, test_stack_pool_bounds_and_reuse) {
    k_thread_stack_t* stacks[CONFIG_SENDSPIN_THREAD_COUNT];
    zassert_is_null(zephyr_thread_stack_alloc(CONFIG_SENDSPIN_THREAD_STACK_SIZE + 1));
    for (auto& stack : stacks) {
        stack = zephyr_thread_stack_alloc(CONFIG_SENDSPIN_THREAD_STACK_SIZE);
        zassert_not_null(stack);
    }
    zassert_is_null(zephyr_thread_stack_alloc(CONFIG_SENDSPIN_THREAD_STACK_SIZE));
    for (auto* stack : stacks) {
        zephyr_thread_stack_free(stack);
    }
    auto* reused = zephyr_thread_stack_alloc(CONFIG_SENDSPIN_THREAD_STACK_SIZE);
    zassert_not_null(reused);
    zephyr_thread_stack_free(reused);
}

ZTEST(sendspin_zephyr, test_client_refuses_exhausted_stacks_and_can_restart) {
    OfflineNetwork network;
    SendspinClient client(SendspinClientConfig{});
    client.set_network_provider(&network);
    k_thread_stack_t* stacks[CONFIG_SENDSPIN_THREAD_COUNT];
    for (auto& stack : stacks) {
        stack = zephyr_thread_stack_alloc(CONFIG_SENDSPIN_THREAD_STACK_SIZE);
        zassert_not_null(stack);
    }
    // No protocol worker can be created. start() must return false instead of
    // waiting for an idle notification from a thread that does not exist.
    zassert_false(client.start());
    for (auto* stack : stacks) {
        zephyr_thread_stack_free(stack);
    }
    // Control: a refused start must release its bindings so the same client can retry.
    zassert_true(client.start());
    client.stop();
}

ZTEST(sendspin_zephyr, test_workers_with_kernel_heap_pressure) {
    // Match the application heap: C++ objects and networking leave too little
    // room for even one dynamic worker stack. Reserved stacks must still work.
    void* pressure = k_malloc(CONFIG_HEAP_MEM_POOL_SIZE - 11000);
    zassert_not_null(pressure);
    auto* dynamic = k_thread_stack_alloc(CONFIG_SENDSPIN_THREAD_STACK_SIZE, 0);
    zassert_is_null(dynamic);
    for (int cycle = 0; cycle < 2; ++cycle) {
        EventFlags flags;
        flags.create();
        PlatformThread workers[3];
        for (auto& worker : workers) {
            worker = PlatformThread(
                [](EventFlags* ready) { ready->wait(1, false, false, UINT32_MAX); }, &flags);
        }
        flags.set(1);
        for (auto& worker : workers) {
            worker.join();
        }
    }
    k_free(pressure);
}
#endif

ZTEST_SUITE(sendspin_zephyr, nullptr, nullptr, nullptr, nullptr, nullptr);
```

## src/transport.cpp
```c
// Copyright 2026 Sendspin Contributors
// SPDX-License-Identifier: Apache-2.0
#include "client_connection.h"
#include "platform/event_flags.h"
#include "platform/time.h"
#include "protocol_task.h"
#include <psa/crypto.h>
#include <zephyr/net/socket.h>
#include <zephyr/sys/base64.h>
#include <zephyr/ztest.h>

#include <cerrno>
#include <cstring>
#include <string>

using namespace sendspin;

namespace {
struct Peer {
    int listener{-1};
    EventFlags flags;
    bool success{false};
    bool client_closed{false};
};

bool read_request(int fd, std::string& request) {
    while (request.find("\r\n\r\n") == std::string::npos && request.size() < 2048) {
        zsock_pollfd poll{fd, ZSOCK_POLLIN, 0};
        if (zsock_poll(&poll, 1, 2000) <= 0) {
            return false;
        }
        char buffer[256];
        const int count = zsock_recv(fd, buffer, sizeof(buffer), 0);
        if (count <= 0) {
            return false;
        }
        request.append(buffer, count);
    }
    return request.find("GET /sendspin?test=1 HTTP/1.1\r\n") == 0;
}

bool upgrade(int fd) {
    std::string request;
    if (!read_request(fd, request)) {
        return false;
    }
    const std::string header = "Sec-WebSocket-Key: ";
    const size_t begin = request.find(header);
    if (begin == std::string::npos) {
        return false;
    }
    const size_t end = request.find("\r\n", begin);
    std::string key = request.substr(begin + header.size(), end - begin - header.size());
    key += "258EAFA5-E914-47DA-95CA-C5AB0DC85B11";
    uint8_t digest[20];
    size_t digest_len = 0;
    if (psa_hash_compute(PSA_ALG_SHA_1, reinterpret_cast<const uint8_t*>(key.data()), key.size(),
                         digest, sizeof(digest), &digest_len) != PSA_SUCCESS) {
        return false;
    }
    uint8_t accept[32]{};
    size_t length = 0;
    if (base64_encode(accept, sizeof(accept), &length, digest, sizeof(digest)) != 0) {
        return false;
    }
    const std::string response = "HTTP/1.1 101 Switching Protocols\r\nUpgrade: websocket\r\n"
                                 "Connection: Upgrade\r\nSec-WebSocket-Accept: " +
                                 std::string(reinterpret_cast<char*>(accept), length) + "\r\n\r\n";
    return zsock_send(fd, response.data(), response.size(), 0) == int(response.size());
}

bool exchange(int ws) {
    uint8_t received[32];
    uint32_t type = 0;
    uint64_t remaining = 0;
    int count = websocket_recv_msg(ws, received, sizeof(received), &type, &remaining, 2000);
    if (count != 3 || remaining != 0 || (type & WEBSOCKET_FLAG_BINARY) == 0 ||
        std::memcmp(received, "out", 3) != 0) {
        return false;
    }
    uint8_t large[3000];
    std::memset(large, 0x5a, sizeof(large));
    if (websocket_send_msg(ws, large, sizeof(large), WEBSOCKET_OPCODE_DATA_BINARY, false, true,
                           2000) != sizeof(large)) {
        return false;
    }
    const auto send = [ws](const char* text, websocket_opcode opcode, bool final) {
        const size_t len = std::strlen(text);
        return websocket_send_msg(ws, reinterpret_cast<const uint8_t*>(text), len, opcode, false,
                                  final, 2000) == int(len);
    };
    if (!send("hel", WEBSOCKET_OPCODE_DATA_TEXT, false) ||
        !send("probe", WEBSOCKET_OPCODE_PING, true)) {
        return false;
    }
    count = websocket_recv_msg(ws, received, sizeof(received), &type, &remaining, 2000);
    if (count != 5 || remaining != 0 || (type & WEBSOCKET_FLAG_PONG) == 0 ||
        std::memcmp(received, "probe", 5) != 0) {
        return false;
    }
    return send("lo", WEBSOCKET_OPCODE_CONTINUE, true) &&
           send("again", WEBSOCKET_OPCODE_DATA_TEXT, true);
}

void serve(Peer* peer) {
    zsock_pollfd poll{peer->listener, ZSOCK_POLLIN, 0};
    const int fd =
        zsock_poll(&poll, 1, 2000) > 0 ? zsock_accept(peer->listener, nullptr, nullptr) : -1;
    uint8_t buffer[512];
    int ws = -1;
    if (fd >= 0 && upgrade(fd)) {
        ws = websocket_register(fd, buffer, sizeof(buffer));
        if (ws >= 0) {
            peer->success = exchange(ws);
        }
    }
    peer->flags.set(1);
    peer->flags.wait(2, true, true, UINT32_MAX);
    // The connection owner cancels and joins its worker after releasing this wait.
    // A blocking read proves the peer sees EOF; the suite watchdog guards hangs.
    if (fd >= 0) {
        // The WebSocket close frame may precede TCP EOF; consume it too.
        int count;
        do {
            count = zsock_recv(fd, buffer, sizeof(buffer), 0);
        } while (count > 0);
        peer->client_closed = count == 0 || (count < 0 && errno == ECONNRESET);
    }
    if (fd >= 0) {
        zsock_shutdown(fd, ZSOCK_SHUT_RDWR);
    }
    if (ws >= 0) {
        websocket_disconnect(ws);
    }
    if (fd >= 0) {
        zsock_close(fd);
    }
}
}  // namespace

ZTEST(sendspin_zephyr, test_websocket_frames_ping_fragmentation_and_cancellation) {
    Peer peer;
    peer.flags.create();
    peer.listener = zsock_socket(AF_INET, SOCK_STREAM, IPPROTO_TCP);
    zassert_true(peer.listener >= 0);
    sockaddr_in address{};
    address.sin_family = AF_INET;
    zassert_equal(zsock_inet_pton(AF_INET, "127.0.0.1", &address.sin_addr), 1);
    zassert_ok(zsock_bind(peer.listener, reinterpret_cast<sockaddr*>(&address), sizeof(address)));
    zassert_ok(zsock_listen(peer.listener, 1));
    socklen_t size = sizeof(address);
    zassert_ok(zsock_getsockname(peer.listener, reinterpret_cast<sockaddr*>(&address), &size));
    PlatformThread server(serve, &peer);
    ProtocolTask protocol(2);
    InboundRing ring;
    zassert_true(ring.create(16384, MemoryLocation::PREFER_INTERNAL, 4096));
    {
        SendspinClientConnection connection(
            "ws://127.0.0.1:" + std::to_string(ntohs(address.sin_port)) + "/sendspin?test=1");
        connection.attach_inbound(&ring, &protocol);
        connection.inbound_gate().set_admitted(true);
        connection.start();
        const int64_t deadline = platform_time_us() + 2000000;
        while (!connection.is_connected() && platform_time_us() < deadline) {
            k_sleep(K_MSEC(1));
        }
        zassert_true(connection.is_connected());
        zassert_equal(connection.send_binary_message(reinterpret_cast<const uint8_t*>("out"), 3),
                      SsErr::OK);
        zassert_equal(peer.flags.wait(1, false, true, 3000) & 1, 1);
        zassert_true(peer.success);
        size_t message_size = 0;
        void* item = ring.take(&message_size, 1000);
        zassert_not_null(item);
        zassert_equal(message_size, 3000);
        for (size_t i = 0; i < message_size; ++i) {
            zassert_equal(inbound_item_bytes(item)[i], 0x5a);
        }
        ring.return_item(item);
        for (const char* expected : {"hello", "again"}) {
            item = ring.take(&message_size, 1000);
            zassert_not_null(item);
            zassert_equal(message_size, 5);
            zassert_mem_equal(inbound_item_bytes(item), expected, 5);
            ring.return_item(item);
        }
        connection.detach_inbound();
        connection.close_transport_now();
        peer.flags.set(2);
    }
    server.join();
    zassert_true(peer.client_closed);
    zsock_close(peer.listener);
    ring.reset();
}
```
