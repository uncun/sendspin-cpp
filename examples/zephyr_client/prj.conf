## CMakeLists.txt
```
# SPDX-License-Identifier: Apache-2.0
cmake_minimum_required(VERSION 3.20.0)
find_package(Zephyr REQUIRED HINTS $ENV{ZEPHYR_BASE})
project(sendspin_zephyr_client LANGUAGES C CXX)
target_sources(app PRIVATE src/main.cpp)
```

## Kconfig
```
# SPDX-License-Identifier: Apache-2.0
mainmenu "Sendspin Zephyr client"
source "Kconfig.zephyr"

config SENDSPIN_SAMPLE_SERVER_URL
	string "Sendspin server WebSocket URL"
	default "ws://192.0.2.1:8927/sendspin"
```

## prj.conf
```kconfig
CONFIG_CPP=y
CONFIG_STD_CPP20=y
CONFIG_SENDSPIN=y
CONFIG_SENDSPIN_ENABLE_PLAYER=n
CONFIG_NETWORKING=y
CONFIG_NET_IPV4=y
CONFIG_NET_TCP=y
CONFIG_NET_DHCPV4=y
CONFIG_DNS_RESOLVER=y
CONFIG_NET_CONFIG_SETTINGS=y
CONFIG_NET_CONFIG_NEED_IPV4=y
CONFIG_NET_CONFIG_AUTO_INIT=y
CONFIG_ENTROPY_GENERATOR=y
CONFIG_MAIN_STACK_SIZE=8192
CONFIG_HEAP_MEM_POOL_SIZE=65536
CONFIG_LOG=y
```

## boards/qemu_cortex_a9.conf
```kconfig
# Build demonstration only: the loopback interface has no external Sendspin server.
# These random generators are insecure and must never be used in a product.
CONFIG_TEST_RANDOM_GENERATOR=y
CONFIG_TEST_CSPRNG_GENERATOR=y
CONFIG_NET_LOOPBACK=y
CONFIG_NET_QEMU_SLIP=y
CONFIG_NET_SLIP_TAP=n
CONFIG_NEWLIB_LIBC=y
CONFIG_NEWLIB_LIBC_MIN_REQUIRED_HEAP_SIZE=262144
CONFIG_NEWLIB_LIBC_FLOAT_PRINTF=y
```

## src/main.cpp
```c
// Copyright 2026 Sendspin Contributors
// SPDX-License-Identifier: Apache-2.0
#include <zephyr/kernel.h>
#include <zephyr/net/net_if.h>

#include <sendspin/client.h>
#include <sendspin/metadata_role.h>

#include <cstdio>

class Network final : public sendspin::SendspinNetworkProvider {
public:
    bool is_network_ready() override {
        auto* iface = net_if_get_default();
        return iface != nullptr && net_if_is_up(iface) &&
               net_if_ipv4_get_global_addr(iface, NET_ADDR_PREFERRED) != nullptr;
    }
};

class Listener final : public sendspin::SendspinClientListener {
public:
    void on_display_pairing_code(const std::string& code,
                                 sendspin::SendspinPairingCodeFormat) override {
        std::printf("Sendspin pairing code: %s\n", code.c_str());
    }
};

int main() {
    Network network;
    Listener listener;
    sendspin::SendspinClientConfig config;
    config.name = "Zephyr Sendspin";
    config.pairing_code_out_channels = {sendspin::SendspinPairingCodeChannel::DISPLAY};
    config.pairing_code_formats = {sendspin::SendspinPairingCodeFormat::DIGITS};
    sendspin::SendspinClient client(config);
    client.set_network_provider(&network);
    client.set_listener(&listener);
    client.add_metadata();
    client.add_controller();
    // This minimal example keeps its identity and pairing records only for this boot.
    // A product should supply SendspinPersistenceProvider backed by Zephyr settings/NVS.
    if (!client.start()) {
        std::printf("Sendspin startup failed\n");
        return 0;
    }
    bool connecting = false;
    for (;;) {
        client.loop();
        const bool ready = network.is_network_ready();
        if (ready && !connecting) {
            client.connect_to(CONFIG_SENDSPIN_SAMPLE_SERVER_URL);
            connecting = true;
        }
        if (!ready) {
            connecting = false;
        }
        k_sleep(K_MSEC(10));
    }
}
```
